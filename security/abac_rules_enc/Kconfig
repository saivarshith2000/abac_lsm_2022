## security/abac_rules_enc/Kconfig
```kconfig
# SPDX-License-Identifier: GPL-2.0-only
config SECURITY_ABAC_RULES_ENC
	bool "ABAC Rules model support with encoded rules and attributes"
	depends on SECURITY
	default y
	help
	  This enables the Attribute Based Access Control LSM based on encoded object-specific rules.
```

## security/abac_trees/Kconfig
```kconfig
# SPDX-License-Identifier: GPL-2.0-only
config SECURITY_ABAC_TREES
	bool "ABAC Trees model support"
	depends on SECURITY
	default y
	help
	  This enables the Attribute Based Access Control LSM based on object-specific PolTrees.
```

## security/abac_trees_enc/Kconfig
```kconfig
# SPDX-License-Identifier: GPL-2.0-only
config SECURITY_ABAC_TREES_ENC
	bool "ABAC Trees model support with encoded rules and attributes"
	depends on SECURITY
	default y
	help
	  This enables the Attribute Based Access Control LSM based on encoded object-specific PolTrees.
```
